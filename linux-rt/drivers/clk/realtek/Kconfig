## linux-rt/drivers/clk/realtek/Kconfig
```kconfig
config COMMON_CLK_REALTEK
	bool "Clock driver for realtek"
	select RTK_MMIO 
	select RESET_CONTROLLER

config COMMON_CLK_REALTEK_DEBUG
	bool "Clock debug"
	select RTK_REGISTER_TRACKER
	default y
	help
	  Add a simple register tracker to clock

config CLK_PLL_PSAUD
	bool

config CLK_PLL_DIF
	bool

config RESET_PLATFORM
	bool

config COMMON_CLK_RTD119X
	bool "Clock driver for RTD119x"
	select COMMON_CLK_REALTEK
	default y if ARCH_RTD119X

config COMMON_CLK_RTD129X
	bool "Clock driver for RTD129x"
	select COMMON_CLK_REALTEK
	default y if ARCH_RTD129x

config COMMON_CLK_RTD139X
	bool "Clock driver for RTD139x"
	select COMMON_CLK_REALTEK
	default y if ARCH_RTD139x

config COMMON_CLK_RTD16XX
	bool "Clock driver for RTD16xx"
	select COMMON_CLK_REALTEK
	select CLK_PLL_PSAUD
	select CLK_PLL_DIF
	select RESET_PLATFORM
	default y if ARCH_RTD16xx

config COMMON_CLK_RTD13XX
	bool "Clock driver for RTD13xx"
	select COMMON_CLK_REALTEK
	select RESET_PLATFORM

config COMMON_CLK_DUMMY
	bool "Dummy Clock"
	help
	  Dummy Clock, if not sure say N.
```

## linux-rt/drivers/soc/realtek/common/Kconfig
```kconfig
config RTK_SB2_SECURITY_DEBG
	bool "Realtek system bridge security mode debug"
	depends on HAVE_ARM_SMCCC
	default n
	help
	  Enable helper functions for Realtek system bridge security mode debug. If unsure, say N.

config RTK_RBUS_BARRIER
	bool "Realtek rbus barrier"
	depends on RTK_MEM_REMAP
	default y
	help
	  Enable helper functions for R-bus barrier. If unsure, say N.

config RTK_MEM_REMAP
	bool "Realtek memory remap"
	default y
	help
	  Enable helper functions for static ioremap. If unsure, say N.

config RTK_ACPU_RELOAD
	bool "Realtek dynamic ACPU reload"
	default n
	help
	  Dynamic ACPU stop/start mechanism. If unsure, say N.

config RTK_IPCSHM_RESET
	bool "Dynamic IPC share memory reset"
	depends on RTK_ACPU_RELOAD
	default n
	help
	  Reset IPC_SHM when performing dynamic ACPU stop/start. If unsure, say N.

config RTK_REGMAP_I2C
	bool
	select REGMAP

config RTK_REGMAP_MMIO
	bool
	select REGMAP

config RTK_REGMAP_SECURE_MMIO
	bool
	select RTK_REGMAP_MMIO
	depends on HAVE_ARM_SMCCC

config RTK_MMIO
	bool
	select REGMAP_MMIO

config RTK_SECURE_DVFS
	bool
	default y if ARCH_RTD16xx
	select RTK_REGMAP_SECURE_MMIO
	select I2C_RTK_SECURE_ACCESS

config RTK_MCP
	bool "Realtek MCP driver"
	default n
	help
	  Realtek MCP driver

config RTK_DUMMY_DEVICE
	bool "Dummy device"
	default n
	select POWER_CONTROL_PD_DUMMY
	help
	  A dummy device driver. If unsure, say No.

config RTK_VMX_ULTRA
	bool "VMX ultra boot enable"
	default n
	select RTK_VMX_DRM
	help
	  Set VMX ultra boot enable.

config RTK_VMX_DRM
	bool "VMX DRM"
	default n
	help
	  Enable VMX DRM.

config RTK_DEMOD
	tristate "Realtek Demod Device Driver"
	default y
	depends on ARCH_RTD16xx
	help
	  This driver provides PM and userspace driver interface of Demod.

config RTK_TP
	tristate "Realtek TP Device Driver"
	default y
	depends on ARCH_RTD16xx
	help
	  This driver provides PM and userspace driver interface of TP.

config RTK_R2RDSC
	tristate "Realtek R2RDSC Device Driver"
	default y
	depends on ARCH_RTD16xx
	help
	  This driver provides PM and userspace driver interface of R2RDSC.

config RTK_DCSYS
	tristate "Realtek DCSYS Device Drviver"
	depends on RTK_PERFCNT
	help
	  This driver provides support of multiple comsumers for using PC.

config RTK_DMC
	tristate "Realtek DMC Device Driver"
	depends on RTK_PERFCNT
	help
	  This driver provides support of multiple comsumers for using PC,
	  and safty DMC register access.


source "drivers/soc/realtek/common/Kconfig.workaround"
source "drivers/soc/realtek/common/rpc/Kconfig"
source "drivers/soc/realtek/common/pwrctrl/Kconfig"
source "drivers/soc/realtek/common/hse/Kconfig"
source "drivers/soc/realtek/common/debug/Kconfig"
source "drivers/soc/realtek/common/perfcnt/Kconfig"
```

## linux-rt/drivers/soc/realtek/common/debug/Kconfig
```kconfig
config RTK_REGISTER_TRACKER
	bool

config RTK_POWER_TRACKER
	bool

config RTK_POWER_TRACKER_MALI
	bool "Power tracker for Mali"
	select RTK_POWER_TRACKER
	help
	  Power tracker for Mali

config RTK_POWER_TRACKER_TEST
	bool "Power tracker timing test"
	select RTK_POWER_TRACKER

config RTK_SRR_READER
	bool "SRR Reader"
	depends on HAVE_ARM_SMCCC
	depends on ARCH_RTD16xx
	depends on DEBUG_FS
	default y
```

## linux-rt/drivers/soc/realtek/rtd16xx/Kconfig
```kconfig
menu "RTD16xx General Setup"

config THOR_PM_WORKARURD
	bool "System restart workarurd"
	depends on RTK_WATCHDOG
	help
	  For SQA test.

config RTK_PSCI_BOOT
	bool "RTK PSCI boot method"
	default n
	help
	  Using PSCI method to control slave CPU power.

endmenu #RTD16xx general setup

menu "RTD16xx Device Drivers"

source "drivers/soc/realtek/rtd16xx/rtk_ve/Kconfig"

endmenu #RTD16xx Device Drivers
```

## linux-rtk/drivers/soc/realtek/common/Kconfig.workaround
```kconfig
config RTK_WORKAROUND_ARM_PMUV3
	bool
	depends on ARM_PMUV3 && ARCH_RTD139x
	default y
```

## linux-rtk/drivers/soc/realtek/rtd139x/Kconfig
```kconfig
menu "RTD139x Device Drivers"

config RTK_FAN
        bool "Realtek Fan driver"
        default n
        help
          Realtek Fan driver

source "drivers/soc/realtek/rtd139x/rtk_ve/Kconfig"

endmenu #RTD139x Device Drivers
```

## linux-rtk/drivers/soc/realtek/rtd13xx/Kconfig
```kconfig
menu "RTD13xx General Setup"

config RTK_PSCI_BOOT
	bool "RTK PSCI boot method"
	default n
	help
	  Using PSCI method to control slave CPU power.

endmenu #RTD13xx general setup

menu "RTD13xx Device Drivers"

source "drivers/soc/realtek/rtd13xx/rtk_ve/Kconfig"

endmenu #RTD13xx Device Drivers
```
